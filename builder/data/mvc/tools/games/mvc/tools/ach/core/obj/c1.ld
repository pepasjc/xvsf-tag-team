OUTPUT_ARCH(mips) ENTRY(_start) SECTIONS { . = 0x8000a900; .all : { KEEP(*(.text.entry)) KEEP(*(.keeptext)) KEEP(*(.keep*)) *(.text*) *(.rodata*) *(.data*) *(.sdata*) *(.bdat) *(.sbss*) *(.bss*) *(COMMON) . = ALIGN(4); } PROVIDE(_ro0_s = 0); PROVIDE(_ro0_e = 0); PROVIDE(_ro1_s = 0); PROVIDE(_ro1_e = 0); PROVIDE(_ro2_s = 0); PROVIDE(_ro2_e = 0); PROVIDE(_ro3_s = 0); PROVIDE(_ro3_e = 0); PROVIDE(_ro4_s = 0); PROVIDE(_ro4_e = 0); PROVIDE(_ro5_s = 0); PROVIDE(_ro5_e = 0); PROVIDE(_ro6_s = 0); PROVIDE(_ro6_e = 0); /DISCARD/ : { *(.comment) *(.pdr) *(.reginfo) *(.MIPS.*) *(.gnu.*) *(.note*) } }