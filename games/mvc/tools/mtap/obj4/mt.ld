SECTIONS {  .s0 0x80010000 : { KEEP(mtcore.o(.text.mt_select)) KEEP(mtcore.o(.text.route_v)) KEEP(mtcore.o(.text.vs_body)) KEEP(mtcore.o(.text.kc.point)) KEEP(mtcore.o(.text.kc.fight)) KEEP(mtcore.o(.text.mt_mask_v)) KEEP(mtcore.o(.text.mt_vsconf)) KEEP(mtcore.o(.bss.kz.mtv)) KEEP(mtcore.o(.text.mt_tick)) KEEP(mtcore.o(.text.mt_mask_stock)) KEEP(mtcore.o(.text.vs_magic)) KEEP(mtcore.o(.bss.vsmbyte)) KEEP(mtcore.o(.bss.kz.ssec)) . = ALIGN(4); } /DISCARD/ : { *(*) } }